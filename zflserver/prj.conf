## CMakeLists.txt
```
# SPDX-License-Identifier: Apache-2.0

cmake_minimum_required(VERSION 3.20.0)
find_package(Zephyr REQUIRED HINTS $ENV{ZEPHYR_BASE})
project(dumb_http_server)

FILE(GLOB app_sources src/*)
target_sources(app PRIVATE ${app_sources})

set(my_dir /home/bawj/projects/fyp/zephyrproject/zephyr/zfl/zflserver)
set(gen_dir ${ZEPHYR_BINARY_DIR}/include/generated/)
set(source_file src/data/train-images-1)
generate_inc_file_for_target(app ${source_file} ${gen_dir}/train-images.bin.inc)
set(source_file src/data/train-labels-1)
generate_inc_file_for_target(app ${source_file} ${gen_dir}/train-labels.bin.inc)

include(${ZEPHYR_BASE}/samples/net/common/common.cmake)
#
# # The external static library that we are linking with does not know
# # how to build for this platform so we export all the flags used in
# # this zephyr build to the external build system.
# #
# # Other external build systems may be self-contained enough that they
# # do not need any build information from zephyr. Or they may be
# # incompatible with certain zephyr options and need them to be
# # filtered out.
# zephyr_get_include_directories_for_lang_as_string(       C includes)
# zephyr_get_system_include_directories_for_lang_as_string(C system_includes)
# zephyr_get_compile_definitions_for_lang_as_string(       C definitions)
# zephyr_get_compile_options_for_lang_as_string(           C options)
#
# set(external_project_cflags
#   "${includes} ${definitions} ${options} ${system_includes}"
#   )
# include(ExternalProject)
#
# # Add an external project to be able download and build the third
# # party library. In this case downloading is not necessary as it has
# # been committed to the repository.
# set(mylib_src_dir   ${my_dir}/src/zlib-1.3)
# set(mylib_build_dir ${my_dir})
#
# set(MYLIB_LIB_DIR     ${mylib_build_dir})
# set(MYLIB_INCLUDE_DIR ${mylib_src_dir})
#
# if(CMAKE_GENERATOR STREQUAL "Unix Makefiles")
# # https://www.gnu.org/software/make/manual/html_node/MAKE-Variable.html
# set(submake "$(CMAKE)")
# else() # Obviously no MAKEFLAGS. Let's hope a "make" can be found somewhere.
# set(submake "make")
# endif()
#
# ExternalProject_Add(
#   mylib_project                 # Name for custom target
#   PREFIX     ${mylib_build_dir} # Root dir for entire project
#   SOURCE_DIR ${mylib_src_dir}
#   BINARY_DIR ${mylib_src_dir} # This particular build system is invoked from the root
#   CONFIGURE_COMMAND ""    # Skip configuring the project, e.g. with autoconf
#   BUILD_COMMAND
#   ${submake}
#   PREFIX=${mylib_build_dir}
#   CC=${CMAKE_C_COMPILER}
#   AR=${CMAKE_AR}
#   CFLAGS=${external_project_cflags}
#   INSTALL_COMMAND ""      # This particular build system has no install command
#   BUILD_BYPRODUCTS ${MYLIB_LIB_DIR}/libmylib.a
#   )
#
# # Create a wrapper CMake library that our app can link with
# add_library(mylib_lib STATIC IMPORTED GLOBAL)
# add_dependencies(
#   mylib_lib
#   mylib_project
#   )
# set_target_properties(mylib_lib PROPERTIES IMPORTED_LOCATION             ${MYLIB_LIB_DIR}/libmylib.a)
# set_target_properties(mylib_lib PROPERTIES INTERFACE_INCLUDE_DIRECTORIES ${MYLIB_INCLUDE_DIR})
#
# target_link_libraries(app PUBLIC mylib_lib)
```

## prj.conf
```kconfig
CONFIG_SRAM_SIZE=32768
# General config
CONFIG_NEWLIB_LIBC=y

# Networking config
CONFIG_NETWORKING=y
CONFIG_NET_IPV4=y
CONFIG_NET_IPV6=y
CONFIG_NET_TCP=y
CONFIG_NET_SOCKETS=y
CONFIG_NET_SOCKETS_POSIX_NAMES=y
CONFIG_NET_CONNECTION_MANAGER=y

# Network driver config
CONFIG_TEST_RANDOM_GENERATOR=y
# Kernel options
CONFIG_MAIN_STACK_SIZE=1048576
CONFIG_KERNEL_VM_SIZE=0x1F00000
CONFIG_KERNEL_MEM_POOL=y
CONFIG_HEAP_MEM_POOL_SIZE=20971520
CONFIG_ENTROPY_GENERATOR=y
CONFIG_INIT_STACKS=y

# Network address config
CONFIG_NET_CONFIG_SETTINGS=y
CONFIG_NET_CONFIG_NEED_IPV4=y
CONFIG_NET_CONFIG_MY_IPV4_ADDR="198.51.100.1"
CONFIG_NET_CONFIG_PEER_IPV4_ADDR="192.0.2.1"
CONFIG_NET_CONFIG_MY_IPV4_GW="192.0.2.1"
CONFIG_NET_CONFIG_MY_IPV6_ADDR="2001:db8:100::1"

CONFIG_ETH_QEMU_IFACE_NAME="zflserver.1"
CONFIG_ETH_QEMU_EXTRA_ARGS="mac=00:00:5e:00:53:01"

# Networking tweaks
# Required to handle large number of consecutive connections,
# e.g. when testing with ApacheBench.
CONFIG_NET_TCP_TIME_WAIT_DELAY=0

# Network debug config
CONFIG_NET_LOG=y
CONFIG_NET_SHELL=y
```

## src/http.h
```c
#ifndef HTTP_H_
#define HTTP_H_

#include <stdbool.h>
#include <stdlib.h>
#include <string.h>

const char GET[] = "GET";
const char POST[] = "POST";
const char CONTENT_LENGTH[] = "Content-Length";

// Client endpoints
const char TRAIN_ENDPOINT[] = "/train";
const char READY_ENDPOINT[] = "/ready";

// Server endpoints
const char ID_ENDPOINT[] = "/id";
const char TRAINING_LABELS_ENDPOINT[] = "/train-labels";
const char TRAINING_IMAGES_ENDPOINT[] = "/train-images";
const char RESULTS_ENDPOINT[] = "/results";
const char SHUTDOWN_ENDPOINT[] = "/shutdown";

typedef struct {
    char *method;
    char *url;

    size_t n_query;
    char **query_keys;
    char **query_vals;

    size_t n_headers;
    char **header_keys;
    char **header_vals;
} Http;

bool is_char(const char *p, const char *c, size_t len) {
    return strncmp(p, c, len) == 0;
}

/**
 * Finds the first occurrence of c of length len in p
 * @return number of bytes to first match
 * @return -1 if no match is found
 */
int find_first_match(const char *p, size_t size, const char *c, size_t len) {
    int processed = 0;
    while (processed < size && *p != '\0' && !is_char(p, c, len)) {
        ++p;
        ++processed;
    }
    if (is_char(p, c, len)) {
        return processed;
    } else {
        return -1;
    }
}

char *substr(const char *p, size_t start, size_t len) {
    char *sub = malloc(len + 1);

    memcpy(sub, &p[start], len);
    sub[len] = '\0';
    return sub;
}

int parse_header(Http *h, const char *payload, size_t len) {
    const char *p = payload;
    bool found = false;

    int method_len = find_first_match(p, len, " ", 1);
    if (method_len == -1) {
        return -1;
    }
    h->method = substr(p, 0, method_len);
    p += method_len + 1;
    len -= method_len + 1;

    int url_len = find_first_match(p, len, " ", 1);
    if (url_len == -1) {
        return -1;
    }
    h->url = substr(p, 0, url_len);
    p += url_len + 1;
    len -= url_len + 1;

    int ret = find_first_match(p, len, "\r\n", 2);
    if (ret == -1) {
        return -1;
    }
    p += ret + 2;
    len -= ret + 2;

    while (len > 0) {
        int header_len = find_first_match(p, len, "\r\n", 2);
        if (header_len > 0) {
            char *header = substr(p, 0, header_len);

            int key_len = find_first_match(header, header_len, ": ", 2);
            if (key_len == -1) {
                return -1;
            }
            char *header_key = substr(header, 0, key_len);
            char *header_val = substr(header, key_len, header_len - key_len);
            ++h->n_headers;
            h->header_keys =
                realloc(h->header_keys, sizeof(*h->header_keys) * h->n_headers);
            h->header_vals =
                realloc(h->header_vals, sizeof(*h->header_vals) * h->n_headers);
            h->header_keys[h->n_headers - 1] = header_key;
            h->header_vals[h->n_headers - 1] = header_val;

            p += header_len + 2;
            len -= header_len + 2;
            found = true;
            free(header);
        } else {
            break;
        }
    }

    return found;
}

int parse_query_param(Http *h) {
    const char *ptr = h->url;
    size_t len = strlen(h->url);
    bool found = false;
    int to_skip = find_first_match(ptr, len, "?", 1);
    if (to_skip == -1) {
        return -1;
    }
    ptr += to_skip + 1;
    len -= to_skip + 1;
    while (len > 0) {
        int param_len = find_first_match(ptr, len, "&", 1);
        if (param_len == -1) {
            param_len = len;
        }
        if (param_len > 0) {
            char *param = substr(ptr, 0, param_len);
            int key_len = find_first_match(param, len, "=", 1);
            if (key_len == -1 || key_len == param_len) {
                return -1;
            }
            char *key = substr(param, 0, key_len);
            char *val = substr(param, key_len + 1, param_len - key_len);
            ++h->n_query;
            h->query_keys =
                realloc(h->query_keys, sizeof(*h->query_keys) * h->n_query);
            h->query_vals =
                realloc(h->query_vals, sizeof(*h->query_vals) * h->n_query);
            h->query_keys[h->n_query - 1] = key;
            h->query_vals[h->n_query - 1] = val;

            found = true;
            free(param);
            ptr += param_len;
            len -= param_len;
        } else {
            break;
        }
    }
    return found;
}

char *get_header(Http *h, const char *key) {
    for (int i = 0; i < h->n_headers; ++i) {
        const char *cur = h->header_keys[i];
        if (strncmp(cur, key, strlen(key)) == 0) {
            return h->header_vals[i];
        }
    }
    return NULL;
}

char *get_param(Http *h, const char *key) {
    for (int i = 0; i < h->n_query; ++i) {
        const char *cur = h->query_keys[i];
        if (strncmp(cur, key, strlen(key)) == 0) {
            return h->query_vals[i];
        }
    }
    return NULL;
}

#endif // !HTTP_H_
```

## src/model.hpp
```c
#ifndef MODEL_H_
#define MODEL_H_

extern const unsigned char g_model[];
extern const int g_model_len;

#endif // !MODEL_H_
```

## src/train.c
```c
#include "train.h"
#include "zephyr/kernel.h"
#define NN_IMPLEMENTATION
#include "nn.h"
#include <string.h>

static const unsigned char train_images[] = {
#include <train-images.bin.inc>
};

static const unsigned char train_labels[] = {
#include <train-labels.bin.inc>
};

#define IMG_HEIGHT 28
#define IMG_WIDTH 28
#define NUM_IMAGES 7500
#define NUM_EPOCHS 100
#define NUM_BATCHES (NUM_IMAGES / NUM_EPOCHS)
#define BATCH_SIZE (NUM_IMAGES / NUM_BATCHES)

size_t arch = {128, 10};

Mat *training_data(Region *r, int from, int to) {
    assert(from < to);
    assert(to <= NUM_IMAGES);

    Mat *training_matrices = k_malloc((to - from) * sizeof(Mat));
    assert(training_matrices);

    // printf("INFO: loading image %d to %d\n", from, to);
    for (int image = from; image < to; ++image) {
        Mat mat_train = mat_alloc(r, 1, 738);
        for (int row = 0; row < IMG_HEIGHT; ++row) {
            for (int col = 0; col < IMG_WIDTH; ++col) {
                float pixel = train_images[row * IMG_HEIGHT + col] / 255.0f;
                MAT_AT(mat_train, 0, row * IMG_HEIGHT + col) = pixel;
            }
        }
        MAT_AT(mat_train, 0, IMG_HEIGHT * IMG_WIDTH + train_labels[image]) =
            train_labels[image];
        training_matrices[image - from] = mat_train;
    }
    return training_matrices;
}

void train() {
    printf("INFO: training image size is %zu\n", sizeof(train_images));
    int label = train_labels[0];
    printf("INFO: Size of labels is %zu\n", sizeof(train_labels));
    // printf("INFO: Label is %d\n", train_labels[0]);

    size_t arch[] = {728, 10};
    float rate = 1.0f;
    Region r = region_alloc_alloc(1024 * 1024);
    NN nn = nn_alloc(&r, arch, ARRAY_LEN(arch));
    nn_rand(nn, -1, 1);
    printf("INFO: NN setup!\n");

    Mat *first_sample = training_data(&r, 0, 1);

    for (int epoch = 0; epoch < 1; ++epoch) {
        printf("INFO: Epoch %d\n", epoch);
        for (int batch = 0; batch < NUM_BATCHES; ++batch) {
            Region temp = region_alloc_alloc(10 * 1024 * 1024);
            int from = batch * BATCH_SIZE;
            Mat *samples = training_data(&temp, from, from + BATCH_SIZE);
            for (int sample = 0; sample < BATCH_SIZE; ++sample) {
                NN g = nn_backprop(&temp, nn, samples[sample]);
                nn_learn(nn, g, rate);
            }
            k_free(temp.words);
            if (batch % 10 == 0 || batch == NUM_BATCHES - 1)
                printf("Batch %d. Cost is: %f\n", batch,
                       nn_cost(nn, first_sample[0]));
        }
    }
}
```

## src/train.cpp
```c
#include "train.h"
#include "model.hpp"

#include <tensorflow/lite/micro/all_ops_resolver.h>
#include <tensorflow/lite/micro/micro_error_reporter.h>
#include <tensorflow/lite/micro/micro_interpreter.h>
#include <tensorflow/lite/micro/system_setup.h>
#include <tensorflow/lite/schema/schema_generated.h>

namespace {
    tflite::ErrorReporter *error_reporter = nullptr;
    const tflite::Model *model = nullptr;
    tflite::MicroInterpreter *interpreter = nullptr;
    TfLiteTensor *input = nullptr;
    TfLiteTensor *output = nullptr;
    int inference_count = 0;

    constexpr int kTensorArenaSize = 2000;
    uint8_t tensor_arena[kTensorArenaSize];
}  /* namespace */

void setup(void) {
    static tflite::MicroErrorReporter micro_error_reporter;

    error_reporter = &micro_error_reporter;

    /* Map the model into a usable data structure. This doesn't involve any
     * copying or parsing, it's a very lightweight operation.
     */
    model = tflite::GetModel(g_model);
    if (model->version() != TFLITE_SCHEMA_VERSION) {
    	TF_LITE_REPORT_ERROR(error_reporter,
    					"Model provided is schema version %d not equal "
    					"to supported version %d.",
    					model->version(), TFLITE_SCHEMA_VERSION);
    	return;
    }

    /* This pulls in all the operation implementations we need.
     * NOLINTNEXTLINE(runtime-global-variables)
     */
    static tflite::AllOpsResolver resolver;

    /* Build an interpreter to run the model with. */
    static tflite::MicroInterpreter static_interpreter(
    	model, resolver, tensor_arena, kTensorArenaSize, error_reporter);
    interpreter = &static_interpreter;
}

void train(void) {
    const int NUM_EPOCHS = 100;
    const int BATCH_SIZE = 100;
    const int IMG_HEIGHT = 28;
    const int IMG_WIDTH = 28;
    const int NUM_TRAININGS = 60000;
    const int NUM_BATCHES = NUM_TRAININGS / BATCH_SIZE;
}
```

## src/train.h
```c
#ifndef TRAIN_H_
#define TRAIN_H_

#ifdef __cplusplus
extern "C" {
#endif

void setup(void);
void train(void);

#ifdef __cplusplus
}
#endif
#endif // !TRAIN_H_
```
