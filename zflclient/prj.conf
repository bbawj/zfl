## CMakeLists.txt
```
# SPDX-License-Identifier: Apache-2.0

cmake_minimum_required(VERSION 3.20.0)
find_package(Zephyr REQUIRED HINTS $ENV{ZEPHYR_BASE})
project(zflclient)

FILE(GLOB app_sources src/*.c)
target_sources(app PRIVATE ${app_sources})

set(my_dir /home/bawj/projects/fyp/zephyrproject/zephyr/zfl/zflserver)
# set(gen_dir ${ZEPHYR_BINARY_DIR}/include/generated/)
# set(source_file src/data/train-images-1)
# generate_inc_file_for_target(app ${source_file} ${gen_dir}/train-images.bin.inc)
# set(source_file src/data/train-labels-1)
# generate_inc_file_for_target(app ${source_file} ${gen_dir}/train-labels.bin.inc)

include(${ZEPHYR_BASE}/samples/net/common/common.cmake)
```

## prj.conf
```kconfig
CONFIG_SRAM_SIZE=15360
# General config
CONFIG_NEWLIB_LIBC=y

# Networking config
CONFIG_NETWORKING=y
CONFIG_NET_TCP=y
CONFIG_NET_SOCKETS=y
CONFIG_NET_SOCKETS_POSIX_NAMES=y
CONFIG_NET_CONNECTION_MANAGER=y

# Network capture
CONFIG_NET_CAPTURE=y
CONFIG_NET_STATISTICS=y
CONFIG_NET_STATISTICS_TCP=y
CONFIG_NET_STATISTICS_USER_API=y

# Network driver config
CONFIG_TEST_RANDOM_GENERATOR=y
# Kernel options
CONFIG_MAIN_STACK_SIZE=8192
CONFIG_KERNEL_VM_SIZE=0x7000000
CONFIG_KERNEL_MEM_POOL=y
CONFIG_HEAP_MEM_POOL_SIZE=10485760
CONFIG_COMMON_LIBC_MALLOC=y
CONFIG_COMMON_LIBC_MALLOC_ARENA_SIZE=-1
CONFIG_ENTROPY_GENERATOR=y
CONFIG_INIT_STACKS=y

# Network address config
CONFIG_NET_IPV4=y
# CONFIG_NET_IPV6=y
CONFIG_NET_CONFIG_SETTINGS=y
# CONFIG_NET_CONFIG_MY_IPV4_ADDR="192.0.2.1"
CONFIG_NET_CONFIG_PEER_IPV4_ADDR="192.0.2.2"
CONFIG_NET_CONFIG_MY_IPV4_GW="192.0.2.2"
# CONFIG_NET_CONFIG_MY_IPV6_ADDR="2001:db8::1"
# CONFIG_NET_CONFIG_PEER_IPV6_ADDR="2001:db8::2"

# CONFIG_ETH_QEMU_IFACE_NAME="zflserver.1"
# CONFIG_ETH_QEMU_EXTRA_ARGS="mac=00:00:5e:00:53:01"

# Networking tweaks
# Required to handle large number of consecutive connections,
# e.g. when testing with ApacheBench.
# CONFIG_NET_TCP_TIME_WAIT_DELAY=0
CONFIG_NET_MGMT_EVENT_QUEUE_SIZE=10
CONFIG_NET_TCP_WORKQ_STACK_SIZE=2048

# Network debug config
CONFIG_LOG=y
CONFIG_LOG_MODE_IMMEDIATE=y
CONFIG_NET_LOG=y
CONFIG_NET_SHELL=y
CONFIG_SHELL=y

CONFIG_THREAD_ANALYZER=y
```

## overlay-e1000.conf
```kconfig
CONFIG_NET_L2_ETHERNET=y
CONFIG_NET_QEMU_ETHERNET=y
CONFIG_NET_DEFAULT_IF_ETHERNET=y

CONFIG_PCIE=y

#CONFIG_ETHERNET_LOG_LEVEL_DBG=y
```

## src/main.c
```c
#include <zephyr/logging/log.h>
LOG_MODULE_REGISTER(zflclient, LOG_LEVEL_DBG);

#include <zephyr/debug/thread_analyzer.h>
#include <zephyr/kernel.h>
#include <zephyr/net/net_core.h>
#include <zephyr/net/net_if.h>
#include <zephyr/net/net_stats.h>
#include <zephyr/net/socket.h>
#include <zephyr/shell/shell.h>

#define NN_IMPLEMENTATION
#define CSON_IMPLEMENTATION
#define SB_IMPLEMENTATION
#define COMMON_IMPLEMENTATION
#define TRAIN_IMPLEMENTATION
#include "../../common.h"
#include "../../http.h"
#include "train.h"
#include <assert.h>
#include <stdio.h>
#include <stdlib.h>
#include <string.h>

#define BIND_PORT 8080
#define PEER_PORT 8080
#define CONFIG_NET_CONFIG_PEER_IPV4_ADDR "192.0.2.2"

#define RANDOM_NN 0

Trainer TRAINER = {0};
int NUM_EPOCHS = 0;
int BATCH_SIZE = 0;

int train_labels_size = 0;
int train_images_size = 0;

static int ID = 0;

static int sendall(int sock, const char *buf, size_t len) {
    while (len > 0) {
        ssize_t out_len = zsock_send(sock, buf, len, 0);

        if (out_len < 0) {
            return out_len;
        }
        buf = (const char *)buf + out_len;
        len -= out_len;
    }

    return 0;
}

int recvall(int sock, StringBuilder *sb) {
    char buf[256];
    size_t total = 0;
    ssize_t r = zsock_recv(sock, buf, sizeof(buf), 0);
    while (r > 0) {
        total += r;
        sb_append(sb, buf, r);
        r = zsock_recv(sock, buf, sizeof(buf), 0);
    }
    if (r < 0) {
        LOG_ERR("Failed to receive data %s\n", strerror(errno));
        return r;
    }
    return total;
}

static void get_stats(Stats *s) {
    struct net_stats_tcp data;

    net_mgmt(NET_REQUEST_STATS_GET_TCP, NULL, &data, sizeof(data));
    s->bytes_sent = data.bytes.sent;
    s->bytes_recv = data.bytes.received;
    s->seg_rexmit = data.rexmit;
    s->seg_dropped = data.drop;
}

int init_model(Token *weights) {
    LOG_INF("Initializing Model, random: %d", RANDOM_NN);
#if RANDOM_NN
    init_nn(NULL, NULL);
#else
    float **initial_weights = malloc(sizeof(float *) * (ARCH_COUNT - 1));
    assert(initial_weights);
    float **initial_bias = malloc(sizeof(float *) * (ARCH_COUNT - 1));
    assert(initial_bias);
    for (int i = 0; i < ARCH_COUNT - 1; ++i) {
        initial_weights[i] = malloc(sizeof(float) * ARCH[i] * ARCH[i + 1]);
        initial_bias[i] = malloc(sizeof(float) * ARCH[i + 1]);
    }
    LOG_INF("Parsing json");
    parse_weights_json(weights, initial_weights, initial_bias, false);
    LOG_INF("Initing nn");
    init_nn(&TRAINER.model, initial_weights, initial_bias);
    for (int i = 0; i < ARCH_COUNT - 1; ++i) {
        free(initial_weights[i]);
        free(initial_bias[i]);
    }
    free(initial_weights);
    free(initial_bias);
#endif /* if RANDOM_NN */

    LOG_INF("NN init!\n");
    return 0;
}

int connect_main_server() {
    int serv;
    int ret;
    struct sockaddr_in addr4;
    addr4.sin_family = AF_INET;
    addr4.sin_port = htons(PEER_PORT);
    LOG_INF("Attempting to connect to %s %d\n",
            CONFIG_NET_CONFIG_PEER_IPV4_ADDR, PEER_PORT);
    zsock_inet_pton(AF_INET, CONFIG_NET_CONFIG_PEER_IPV4_ADDR, &addr4.sin_addr);
    serv = zsock_socket(AF_INET, SOCK_STREAM, IPPROTO_TCP);
    if (serv == -1) {
        LOG_ERR("could not create server socket because %s\n", strerror(errno));
        return -1;
    }
    ret = zsock_connect(serv, (struct sockaddr *)&addr4, sizeof(addr4));
    if (ret < 0) {
        LOG_ERR("could not connect to server socket: %s\n", strerror(errno));
        return ret;
    }
    LOG_INF("Successfully connected to server\n");
    return serv;
}

int send_weights(size_t round_number, int64_t training_time) {
    StringBuilder sb;
    sb_init(&sb, 1024);
    sb_appendf(&sb, "{\"round\": %zu, \"training_time\": %ld, \"weights\": ",
               round_number, training_time);
    weights_to_string(&sb, &TRAINER.model);

    sb_append(&sb, ", ", 2);
    Stats *s = malloc(sizeof(Stats));
    get_stats(s);
    printf("\"stats\": { \"bytes_sent\": %d, \"bytes_recv\": %d, "
           "\"seg_dropped\": %d, \"seg_rexmit\": %d }\n",
           s->bytes_sent, s->bytes_recv, s->seg_dropped, s->seg_rexmit);
    sb_appendf(&sb,
               "\"stats\": { \"bytes_sent\": %d, \"bytes_recv\": %d, "
               "\"seg_dropped\": %d, \"seg_rexmit\": %d }",
               s->bytes_sent, s->bytes_recv, s->seg_dropped, s->seg_rexmit);
    free(s);

    sb_append(&sb, "}", 1);
    char req[256];
    int req_len = snprintf(req, sizeof(req),
                           "POST %s?id=%d \r\nContent-Length: %zu\r\n\r\n",
                           RESULTS_ENDPOINT, ID, sb.size);

    int ret = 0;
    int serv = -1;
    int retries = 3;
    for (int i = 0; i < retries; ++i) {
        LOG_INF("Sending local weights, current tries: %d", i + 1);
        serv = connect_main_server();
        if (serv < 0) {
            continue;
        }
        int ret = sendall(serv, req, req_len);
        if (ret < 0) {
            LOG_ERR("could not send req to socket: %s", strerror(errno));
            if (errno == ENOTCONN) {
                zsock_close(serv);
                continue;
            }
            break;
        }
        ret = sendall(serv, sb.data, sb.size);
        if (ret < 0) {
            LOG_ERR("could not send weights to socket: %s", strerror(errno));
            zsock_close(serv);
            continue;
        }
        break;
    }
    zsock_close(serv);
    sb_free(&sb);
    return ret;
}

void handle_incoming_connection(void *sock, void *x, void *y) {
    int client = *((int *)sock);
    Http h = {0};
    StringBuilder sb = {0};
    sb_init(&sb, 1024);

    int required_len = recv_required_req(&h, &sb, client);
    if (required_len < 0) {
        LOG_ERR("invalid HTTP required header: %.*s", sb.size, sb.data);
        goto clean;
    }
    int optional_len = recv_optional_headers(&h, &sb, client, required_len);
    if (optional_len < 0) {
        LOG_ERR("invalid HTTP optional headers: %.*s", sb.size, sb.data);
        goto clean;
    }

    parse_query_param(&h);
    LOG_INF("HTTP request\nMethod: %s, url: %s\n", h.method, h.url);

    if (strncmp(h.url, TRAIN_ENDPOINT, strlen(TRAIN_ENDPOINT)) == 0) {
        char *content_len_str = get_header(&h, CONTENT_LENGTH);
        if (content_len_str == NULL) {
            LOG_ERR("no training data received\n");
            goto clean;
        }
        char *endptr;
        size_t content_len = strtol(content_len_str, &endptr, 10);
        size_t offset = required_len + optional_len;
        int ret = recv_content(&sb, client, offset, content_len);
        if (ret == -1) {
            LOG_ERR("Could not recv all %zu bytes of content, required: %d, "
                    "optional: %d, current: %zu",
                    content_len, required_len, optional_len, sb.size);
            goto clean;
        }
        char *content = substr(sb.data, offset, content_len);

        Payload p = {0};
        deserialize_training_data(content, content_len, &p);
        init_model(p.weights);

        LOG_INF("Starting training");
        int64_t start = k_uptime_get();
        train(&TRAINER);
        int64_t end = k_uptime_get();

        send_weights(p.round_number, (end - start) / 1000);

        free_tokens(p.json);
        free(content);
    } else if (strncmp(h.url, READY_ENDPOINT, strlen(READY_ENDPOINT)) == 0) {
        char *ready = TRAINER.samples_ready ? "true" : "false";
        sendall(client, ready, strlen(ready));
    } else {
        LOG_ERR("404 resource not found: %s\n", h.url);
    }
clean:
    http_free(&h);
    zsock_close(client);
    sb_free(&sb);
    free(sock);
}

#define THREAD_STACK_SIZE 1024
#define THREAD_PRIORITY 5
struct k_thread thread_data;

K_THREAD_STACK_DEFINE(server_stack_area, THREAD_STACK_SIZE);
k_tid_t handle_incoming_connection_async(int *sock) {
    LOG_INF("Attempting to create server thread\n");
    k_tid_t tid = k_thread_create(&thread_data, server_stack_area,
                                  K_THREAD_STACK_SIZEOF(server_stack_area),
                                  handle_incoming_connection, sock, NULL, NULL,
                                  THREAD_PRIORITY, 0, K_NO_WAIT);
    return tid;
}

void start_server() {
    int serv;
    static int counter;
    struct sockaddr_in bind_addr;

    serv = zsock_socket(AF_INET, SOCK_STREAM, IPPROTO_TCP);
    if (serv == -1) {
        LOG_ERR("Could not create server socket because %s\n", strerror(errno));
        return;
    }
    bind_addr.sin_family = AF_INET;
    bind_addr.sin_addr.s_addr = htonl(INADDR_ANY);
    bind_addr.sin_port = htons(BIND_PORT);
    if (zsock_bind(serv, (struct sockaddr *)&bind_addr, sizeof(bind_addr)) ==
        -1) {
        LOG_ERR("Could not bind server socket because %s\n", strerror(errno));
        return;
    }

    if (zsock_listen(serv, 5) == -1) {
        LOG_ERR("Could not listen on server socket because %s\n",
                strerror(errno));
        return;
    }

    LOG_INF("HTTP server waits for a connection on "
            "port %d...\n",
            BIND_PORT);

    while (1) {
        struct sockaddr_in client_addr;
        socklen_t client_addr_len = sizeof(client_addr);
        char addr_str[INET_ADDRSTRLEN];
        int client = zsock_accept(serv, (struct sockaddr *)&client_addr,
                                  &client_addr_len);
        if (client < 0) {
            LOG_ERR("Error in accept: %s - continuing\n", strerror(errno));
            continue;
        }
        zsock_inet_ntop(client_addr.sin_family, &client_addr.sin_addr, addr_str,
                        sizeof(addr_str));
        LOG_INF("Connection #%d from %s\n", counter++, addr_str);
        int *sock = malloc(sizeof(int));
        *sock = client;
        handle_incoming_connection_async(sock);
    }
}

char *get_request(const char *endpoint, int *received) {
    char req[256];
    int len = snprintf(req, sizeof(req), "%s %s \r\n\r\n", GET, endpoint);
    LOG_INF("Making get request to %s", req);
    int serv = connect_main_server();
    if (serv < 0) {
        LOG_ERR("could not connect to server: %s\n", strerror(errno));
        zsock_close(serv);
        return NULL;
    }

    int ret = sendall(serv, req, len);
    if (ret < 0) {
        LOG_ERR("could not send to server: %s\n", strerror(errno));
        zsock_close(serv);
        return NULL;
    }
    StringBuilder sb = {0};
    sb_init(&sb, 1024);
    *received = recvall(serv, &sb);
    char *content = sb_string(&sb);
    sb_free(&sb);
    zsock_close(serv);
    return content;
}

int req_id() {
    int received = 0;
    char *id_string = get_request(ID_ENDPOINT, &received);
    if (id_string == NULL) {
        return -1;
    }
    ID = atoi(id_string);
    free(id_string);
    LOG_INF("Client ID is %d", ID);
    return received;
}

char *req_images(int *n) {
    static char image_resource[100];
    snprintf(image_resource, sizeof(image_resource), "%s?id=%d",
             TRAINING_IMAGES_ENDPOINT, ID);
    return get_request(image_resource, n);
}

char *req_labels(int *n) {
    static char label_resource[100];
    snprintf(label_resource, sizeof(label_resource), "%s?id=%d",
             TRAINING_LABELS_ENDPOINT, ID);
    return get_request(label_resource, n);
}

int run(const struct shell *sh, size_t argc, char **argv) {
    if (argc < 2) {
        LOG_ERR("ipv4 address not given");
        return -1;
    }
    char *addr_str = argv[1];
    LOG_INF("instance ipaddr is %s", addr_str);
    struct in_addr addr;
    zsock_inet_pton(AF_INET, addr_str, &addr);
    if (!net_if_ipv4_addr_add(net_if_get_default(), &addr, NET_ADDR_MANUAL,
                              UINT32_MAX)) {
        LOG_ERR("failed to add %s to interface", addr_str);
        return -1;
    }

    NUM_EPOCHS = atoi(argv[2]);
    if (NUM_EPOCHS == 0) {
        LOG_ERR("num epochs: %s is invalid", argv[2]);
        return -1;
    }

    BATCH_SIZE = atoi(argv[3]);
    if (BATCH_SIZE == 0) {
        LOG_ERR("batch size: %s is invalid", argv[3]);
        return -1;
    }

    TRAINER.samples_ready = false;
    TRAINER.samples = (Mat){0};
    TRAINER.model = (NN){0};

    int image_bytes, n_labels;
    req_id();
    char *img_data = req_images(&image_bytes);
    char *label_data = req_labels(&n_labels);
    int n_images = image_bytes / IMG_SIZE;
    if (n_images != n_labels) {
        LOG_ERR("n_images is %d but n_labels is %d, mismatch!", n_images,
                n_labels);
        return -1;
    }

    LOG_INF("n_images is %d, n_labels is %d", n_images, n_labels);
    TRAINER.samples = init_train_set(img_data, label_data, n_images);
    LOG_INF("train set init!");
    TRAINER.n_images = n_images;
    TRAINER.samples_ready = true;
    free(img_data);
    free(label_data);

    start_server();

    return 0;
}

SHELL_CMD_ARG_REGISTER(run, NULL, "Run with IPv4 address", run, 4, 0);

int main(void) { LOG_INF("Ready"); }
```

## src/common.h
```c
#ifndef COMMON_H_
#define COMMON_H_

#include "cson.h"
#include "nn.h"
#include "sb.h"

#define IMG_HEIGHT 28
#define IMG_WIDTH 28
#define IMG_SIZE (IMG_HEIGHT * IMG_WIDTH)
#define HIDDEN_LAYER 16
#define OUTPUT 10
#define ARCH_COUNT 3
#define ARCH                                                                   \
    (size_t[]) { IMG_SIZE, HIDDEN_LAYER, OUTPUT }

void init_train_set(Mat *t, char *img_data, char *label_data, int n_images);
int parse_weights_json(char *bytes, size_t len, float **initial_weights,
                       float **initial_bias, bool accum);
int insert_weights_to_nn(NN nn, float **initial_weights, float **initial_bias);
void init_nn(NN *nn, float **initial_weights, float **initial_bias);
float accuracy(NN nn, Mat t);
char *recv_size(int sock, size_t size);

#ifdef COMMON_IMPLEMENTATION

char *recv_size(int sock, size_t size) {
    if (size == 0) {
        return NULL;
    }
    char *ret = NULL;
    StringBuilder sb = {0};
    sb_init(&sb, size);
    char buf[256];
    size_t total = 0;
    while (total < size) {
        ssize_t r = recv(sock, buf, sizeof(buf), 0);
        if (r <= 0) {
            goto clean;
        }
        total += r;
        sb_append(&sb, buf, r);
    }
    ret = sb_string(&sb);
clean:
    sb_free(&sb);
    return ret;
}

void init_train_set(Mat *t, char *img_data, char *label_data, int n_images) {
    *t = mat_alloc(NULL, n_images, IMG_SIZE + 10);
    printf("alloced!\n");

    for (int image = 0; image < n_images; ++image) {
        for (int row = 0; row < IMG_HEIGHT; ++row) {
            for (int col = 0; col < IMG_WIDTH; ++col) {
                float pixel =
                    img_data[image * IMG_SIZE + row * IMG_WIDTH + col] / 255.0f;
                MAT_AT(*t, image, row * IMG_WIDTH + col) = pixel;
            }
        }
        for (int i = 0; i < OUTPUT; ++i) {
            if (i == label_data[image]) {
                MAT_AT(*t, image, IMG_SIZE + label_data[image]) = 1.0f;
            } else {
                MAT_AT(*t, image, IMG_SIZE + i) = 0.0f;
            }
        }
    }
}

int parse_weights_json(char *bytes, size_t len, float **initial_weights,
                       float **initial_bias, bool accum) {
    Cson c = {0};
    c.b = bytes;
    c.size = len;
    c.cap = len;
    c.cur = 0;

    Token *json = parse_json(&c);
    Token *weights = json->child;
    Token *biases = weights->next;

    if (!accum) {
        for (int i = 0; i < ARCH_COUNT - 1; ++i) {
            initial_weights[i] =
                calloc(1, sizeof(float) * ARCH[i] * ARCH[i + 1]);
            initial_bias[i] = calloc(1, sizeof(float) * ARCH[i + 1]);
        }
    }

    for (size_t i = 0; i < ARCH_COUNT - 1; ++i) {
        Token *row = weights->child;
        for (size_t j = 0; j < ARCH[i]; ++j) {
            Token *col = row->child;
            for (size_t k = 0; k < ARCH[i + 1]; ++k) {
                initial_weights[i][j * ARCH[i + 1] + k] +=
                    strtof(col->text, NULL);
                col = col->next;
            }
            row = row->next;
        }
        weights = weights->next->next;
        Token *bias = biases->child;
        for (size_t j = 0; j < ARCH[i + 1]; ++j) {
            initial_bias[i][j] += strtof(bias->text, NULL);
            bias = bias->next;
        }

        if (biases->next != NULL) {
            biases = biases->next->next;
        }
    }
    free_tokens(json);
    free(bytes);
    return 0;
}

int insert_weights_to_nn(NN nn, float **initial_weights, float **initial_bias) {
    for (size_t i = 0; i < nn.arch_count - 1; ++i) {
        Mat m = nn.ws[i];
        Row r = nn.bs[i];
        for (size_t j = 0; j < m.rows; ++j) {
            for (size_t k = 0; k < m.cols; ++k) {
                MAT_AT(m, j, k) = initial_weights[i][j * m.cols + k];
            }
        }
        for (size_t j = 0; j < r.cols; ++j) {
            ROW_AT(r, j) = initial_bias[i][j];
        }
    }
    return 0;
}

void init_nn(NN *nn, float **initial_weights, float **initial_bias) {
    if (nn->arch_count == 0) {
        *nn = nn_alloc(NULL, ARCH, ARRAY_LEN(ARCH));
    }
    if (initial_weights == NULL || initial_bias == NULL) {
        nn_rand(*nn, -1, 1);
    } else {
        insert_weights_to_nn(*nn, initial_weights, initial_bias);
    }
}

float accuracy(NN nn, Mat t) {
    NN_ASSERT(NN_INPUT(nn).cols + NN_OUTPUT(nn).cols == t.cols);
    size_t n = t.rows;

    float c = 0;
    for (size_t i = 0; i < n; ++i) {
        Row row = mat_row(t, i);
        Row x = row_slice(row, 0, NN_INPUT(nn).cols);
        Row y = row_slice(row, NN_INPUT(nn).cols, NN_OUTPUT(nn).cols);

        row_copy(NN_INPUT(nn), x);
        nn_forward(nn);
        size_t q = y.cols;
        float max = 0;
        size_t max_idx = 0;
        for (size_t j = 0; j < q; ++j) {
            if (ROW_AT(NN_OUTPUT(nn), j) > max) {
                max = ROW_AT(NN_OUTPUT(nn), j);
                max_idx = j;
            }
        }
        for (size_t j = 0; j < q; ++j) {
            if (ROW_AT(y, j) == 1) {
                if (j == max_idx) {
                    ++c;
                }
                break;
            }
        }
    }

    return c / n;
}

#endif // COMMON_IMPLEMENTATION

#endif // !COMMON_H_
```

## src/cson.h
```c
#ifndef CSON_H
#define CSON_H

#include <assert.h>
#include <ctype.h>
#include <stdbool.h>
#include <stdio.h>
#include <stdlib.h>
#include <string.h>
#include <sys/types.h>

#ifndef CSON_ALLOC
#define CSON_ALLOC malloc
#endif

#ifndef CSON_FREE
#define CSON_FREE free
#endif

#ifndef CSON_PRINT
#define CSON_PRINT printf
#endif

typedef struct {
    char *line;
    size_t len;
} Buffer;

typedef struct {
    char *b;
    size_t cap;
    size_t size;
    size_t cur;
} Cson;

typedef enum {
    NULL_VALUE,
    OBJECT,
    ARRAY,
    STRING,
    NUMBER,
    TRUE,
    FALSE,
} TOKEN_TYPE;

typedef struct Token {
    TOKEN_TYPE type;
    char *text;
    // If exists, the child is the 'value' of the current 'key' token
    struct Token *child;
    // If exists, holds the pointer to the next token at the same level
    struct Token *next;
} Token;

Token *parse_json(Cson *c);
Token *parse_json_file(Cson *c, const char *path);
void free_tokens(Token *t);
void pretty_print(Token *root, int depth);

#ifdef CSON_IMPLEMENTATION

void log_error(Cson *c, char *message) {
    char buf[256];
    snprintf(buf, sizeof(buf), "ERROR: invalid token '%c'. %s", c->b[c->cur],
             message);
    fprintf(stderr, "%s", buf);
}

void init(Cson *c) {
    c->cap = 1024 * 1024;
    c->size = 0;
    c->cur = 0;
    c->b = CSON_ALLOC(c->cap);
    assert(c->b);
}

void append_line(Cson *c, char *line, size_t len) {
    if (c->size + len > c->cap) {
        c->cap *= 2;
        c->b = realloc(c->b, sizeof(char) * c->cap);
        assert(c->b);
    }

    memcpy(&c->b[c->size], line, len);
    c->size += len;
}

void open_file(Cson *c, const char *filename) {
    FILE *fp = fopen(filename, "r");
    if (!fp) {
        exit(0);
    }
    char *line = NULL;
    size_t len = 0;
    ssize_t nread;
    while ((nread = getline(&line, &len, fp)) != -1) {
        append_line(c, line, nread);
    }
    free(line);
    fclose(fp);
}

char advance(Cson *c) {
    if (c->cur == c->size) {
        return '\0';
    }
    return c->b[++c->cur];
}

char peek(Cson *c) {
    if (c->cur == c->size) {
        return '\0';
    }
    return c->b[c->cur];
}

char peek_next(Cson *c) {
    if (c->cur + 1 >= c->size) {
        return '\0';
    }
    return c->b[c->cur + 1];
}

const char *translate_tokentype(TOKEN_TYPE t) {
    switch (t) {
    case 0:
        return "null";
    case OBJECT:
        return "object";
    case ARRAY:
        return "array";
    case STRING:
        return "string";
    case NUMBER:
        return "number";
    case TRUE:
        return "true";
    case FALSE:
        return "false";
    default:
        return NULL;
    }
}

bool scan_number(Cson *c, Token *res) {
    bool neg = false;
    bool fraction = false;
    bool exp = false;
    int start = c->cur;
    size_t len = 1;

    while (true) {
        char cur = peek(c);
        if (cur == '-') {
            if (neg)
                return false;
            char next = peek_next(c);
            if (!isdigit(next))
                return false;
            neg = true;
            advance(c);
            len++;
        } else if (isdigit(cur)) {
            while (true) {
                char next = advance(c);

                if (isdigit(next)) {
                    len++;
                } else if (next == '.') {
                    if (fraction || !isdigit(peek_next(c))) {
                        return false;
                    }
                    fraction = true;
                    len++;
                } else if (next == 'e' || next == 'E') {
                    if (exp)
                        return false;
                    char next_next = peek_next(c);
                    if (next_next == '+' || next_next == '-') {
                        advance(c);
                        len++;
                        char next_next_next = peek_next(c);
                        if (!isdigit(next_next_next))
                            return false;
                    } else if (!isdigit(next_next))
                        return false;

                    exp = true;
                    len++;
                } else {
                    char *text = CSON_ALLOC(len + 1);
                    memcpy(text, &c->b[start], len);
                    text[len] = '\0';
                    res->type = NUMBER;
                    res->text = text;
                    return true;
                }
            }
            return false;
        } else {
            log_error(c, "Expected '-' or digit\n");
            return false;
        }
    }
}

void skip_whitespace(Cson *c) {
    while (true) {
        char cur = peek(c);
        switch (cur) {
        case '\t':
        case '\n':
        case '\r':
        case ' ':
        case '\0':
            advance(c);
            continue;
        default:
            return;
        }
    }
}

char scan_next(Cson *c) {
    advance(c);
    skip_whitespace(c);
    return peek(c);
}

bool scan_string(Cson *c, Token *res) {
    char cur = peek(c);
    if (cur != '"')
        return false;

    size_t len = 0;
    size_t start = c->cur + 1;

    while (true) {
        char next = advance(c);
        len++;

        if (next == '"') {
            if (len == 0) {
                res->text = NULL;
            } else {
                char *text = CSON_ALLOC(len);
                assert(text);
                memcpy(text, &c->b[start], len - 1);
                text[len - 1] = '\0';
                res->text = text;
            }
            res->type = STRING;
            return true;
        } else if (next == '\\') {
            char next_next = advance(c);
            len++;
            switch (next_next) {
            case '"':
            case '\\':
            case '/':
            case 'b':
            case 'f':
            case 'n':
            case 'r':
            case 't':
            case 'u':
                break;
            default:
                fprintf(stderr, "Invalid escape sequence '%c'\n", next_next);
                return false;
            }
        }
    }
}

bool scan_special(Cson *c, Token *res, TOKEN_TYPE special) {
    const char *s = translate_tokentype(special);
    size_t len = strlen(s);
    if (c->cur + len > c->size)
        return false;
    char *temp = CSON_ALLOC(len + 1);
    assert(temp);
    memcpy(temp, &c->b[c->cur], len);
    temp[len] = '\0';

    if (strcmp(temp, s) == 0) {
        res->type = special;
        res->text = temp;
        c->cur += len;
        return true;
    }
    return false;
}

bool scan_token(Cson *c, Token *res);

bool scan_array(Cson *c, Token *res) {
    assert(peek(c) == '[');
    Token *root = res;
    char cur = scan_next(c);
    while (cur != ']') {
        Token *next = CSON_ALLOC(sizeof(Token));
        next->child = NULL;
        next->next = NULL;
        next->text = NULL;
        next->type = 0;

        if (scan_token(c, next)) {
            if (root->child == NULL) {
                root->child = next;
            } else {
                res->next = next;
            }
            res = next;
        } else {
            free(next);
            return false;
        }
        skip_whitespace(c);
        cur = peek(c);
        if (cur == ',') {
            cur = scan_next(c);
        }
    }
    root->type = ARRAY;
    advance(c);
    return true;
}

bool scan_object(Cson *c, Token *res) {
    assert(peek(c) == '{');
    Token *prev = res;
    char cur = scan_next(c);
    while (cur != '}') {
        Token *next = CSON_ALLOC(sizeof(Token));
        assert(next);
        next->child = NULL;
        next->next = NULL;
        next->text = NULL;
        next->type = 0;

        if (!scan_string(c, next)) {
            free(next);
            return false;
        }
        cur = scan_next(c);
        if (cur != ':') {
            free(next);
            fprintf(stderr, "Expected ':' after key\n");
            return false;
        }
        advance(c);
        Token *child = CSON_ALLOC(sizeof(Token));
        assert(child);
        child->child = NULL;
        child->next = NULL;
        child->text = NULL;
        child->type = 0;
        if (!scan_token(c, child)) {
            free(child);
            return false;
        }
        prev->next = next;
        next->child = child;
        prev = next;

        cur = scan_next(c);
        if (cur == ',') {
            advance(c);
        }
    }
    advance(c);
    res->type = OBJECT;
    return true;
}

bool scan_token(Cson *c, Token *res) {
    while (true) {
        skip_whitespace(c);
        char cur = peek(c);
        switch (cur) {
        case '\0':
            return false;
        case '[':
            return scan_array(c, res);
        case '{':
            return scan_object(c, res);
        case '"':
            return scan_string(c, res);
        case 't':
            return scan_special(c, res, TRUE);
        case 'f':
            return scan_special(c, res, FALSE);
        case 'n':
            return scan_special(c, res, 0);
        default:
            return scan_number(c, res);
        }
    }
    return false;
}

void pretty_print(Token *root, int depth) {
    if (root == NULL)
        return;

    while (root != NULL) {
        for (int i = 0; i < depth; i++) {
            CSON_PRINT("\t");
        }
        CSON_PRINT("type: %s, text: %s\n", translate_tokentype(root->type),
                   root->text);

        if (root->child != NULL)
            pretty_print(root->child, depth + 1);
        root = root->next;
    }
}

Token *parse_json(Cson *c) {
    Token *t = CSON_ALLOC(sizeof(Token));
    t->next = NULL;
    t->child = NULL;
    t->text = NULL;
    t->type = 0;
    if (!scan_token(c, t)) {
        if (c->cur == c->size) {
            CSON_PRINT("Reached EOF");
            return NULL;
        }
        CSON_PRINT("An error while parsing char '%c' at position %zu",
                   c->b[c->cur], c->cur);
        return NULL;
    }
    return t;
}

Token *parse_json_file(Cson *c, const char *path) {
    init(c);
    open_file(c, path);
    return parse_json(c);
}

void free_tokens(Token *t) {
    if (t == NULL)
        return;
    while (t != NULL) {
        free_tokens(t->child);
        Token *temp = t->next;
        CSON_FREE(t);
        t = temp;
    }
}

#endif // CSON_IMPLEMENTATION

#endif // ! CSON_H
```

## src/nn.h
```c
#ifndef NN_H_
#define NN_H_

// TODO: make sure nn.h/gym.h is compilable with C++ compiler
// TODO: introduce NNDEF macro for every definition of nn.h

#include <math.h>
#include <stdbool.h>
#include <stddef.h>
#include <stdint.h>
#include <stdio.h>
#include <string.h>

// #define NN_BACKPROP_TRADITIONAL

#ifndef NN_ACT
#define NN_ACT ACT_SIG
#endif // NN_ACT

#ifndef NN_RELU_PARAM
#define NN_RELU_PARAM 0.01f
#endif // NN_RELU_PARAM

#include <stdlib.h>
#define NN_MALLOC malloc

#ifndef NN_ASSERT
#include <assert.h>
#define NN_ASSERT assert
#endif // NN_ASSERT

#define ARRAY_LEN(xs) sizeof((xs)) / sizeof((xs)[0])

typedef enum {
    ACT_SIG,
    ACT_RELU,
    ACT_TANH,
    ACT_SIN,
} Act;

float rand_float(void);

float sigmoidf(float x);
float reluf(float x);
float tanhf(float x);

// Dispatch to the corresponding activation function
float actf(float x, Act act);

// Derivative of the activation function based on its value
float dactf(float y, Act act);

typedef struct {
    size_t capacity;
    size_t size;
    uintptr_t *words;
} Region;

// capacity is in bytes, but it can allocate more just to keep things
// word aligned
Region region_alloc_alloc(size_t capacity_bytes);
void *region_alloc(Region *r, size_t size_bytes);
#define region_reset(r) (NN_ASSERT((r) != NULL), (r)->size = 0)
#define region_occupied_bytes(r)                                               \
    (NN_ASSERT((r) != NULL), (r)->size * sizeof(*(r)->words))
#define region_save(r) (NN_ASSERT((r) != NULL), (r)->size)
#define region_rewind(r, s) (NN_ASSERT((r) != NULL), (r)->size = s)

typedef struct {
    size_t rows;
    size_t cols;
    float *elements;
} Mat;

typedef struct {
    size_t cols;
    float *elements;
} Row;

#define ROW_AT(row, col) (row).elements[col]

Mat row_as_mat(Row row);
#define row_alloc(r, cols) mat_row(mat_alloc(r, 1, cols), 0)
Row row_slice(Row row, size_t i, size_t cols);
#define row_rand(row, low, high) mat_rand(row_as_mat(row), low, high)
#define row_fill(row, x) mat_fill(row_as_mat(row), x);
#define row_print(row, name, padding) mat_print(row_as_mat(row), name, padding)
#define row_copy(dst, src) mat_copy(row_as_mat(dst), row_as_mat(src))

#define MAT_AT(m, i, j) (m).elements[(i) * (m).cols + (j)]

Mat mat_alloc(Region *r, size_t rows, size_t cols);
void mat_fill(Mat m, float x);
void mat_rand(Mat m, float low, float high);
Row mat_row(Mat m, size_t row);
void mat_copy(Mat dst, Mat src);
void mat_dot(Mat dst, Mat a, Mat b);
void mat_sum(Mat dst, Mat a);
void mat_act(Mat m);
void mat_print(Mat m, const char *name, size_t padding);
void mat_shuffle_rows(Mat m);
Mat mat_slice(Mat m, size_t from, size_t n);
#define MAT_PRINT(m) mat_print(m, #m, 0)

typedef struct {
    size_t *arch;
    size_t arch_count;
    Mat *ws; // The amount of activations is arch_count-1
    Row *bs; // The amount of activations is arch_count-1

    // TODO: maybe remove these? It would be better to allocate them in a
    // temporary region during the actual forwarding
    Row *as;
} NN;

#define NN_INPUT(nn) (NN_ASSERT((nn).arch_count > 0), (nn).as[0])
#define NN_OUTPUT(nn)                                                          \
    (NN_ASSERT((nn).arch_count > 0), (nn).as[(nn).arch_count - 1])

NN nn_alloc(Region *r, size_t *arch, size_t arch_count);
void nn_zero(NN nn);
void nn_print(NN nn, const char *name);
#define NN_PRINT(nn) nn_print(nn, #nn);
void nn_rand(NN nn, float low, float high);
// TODO: make nn_forward signature more natural
//
// Something more like `Mat nn_forward(NN nn, Mat in)`
void nn_forward(NN nn);
float nn_cost(NN nn, Mat t);
float nn_cross_entropy(NN nn, Mat t);
NN nn_finite_diff(Region *r, NN nn, Mat t, float eps);
NN nn_backprop(Region *r, NN nn, Mat t);
void nn_learn(NN nn, NN g, float rate);

typedef struct {
    size_t begin;
    float cost;
    bool finished;
} Batch;

void batch_process(Region *r, Batch *b, size_t batch_size, NN nn, Mat t,
                   float rate);

#endif // NN_H_

#ifdef NN_IMPLEMENTATION

float sigmoidf(float x) { return 1.f / (1.f + expf(-x)); }

float reluf(float x) { return x > 0 ? x : x * NN_RELU_PARAM; }

float tanhf(float x) {
    float ex = expf(x);
    float enx = expf(-x);
    return (ex - enx) / (ex + enx);
}

float actf(float x, Act act) {
    switch (act) {
    case ACT_SIG:
        return sigmoidf(x);
    case ACT_RELU:
        return reluf(x);
    case ACT_TANH:
        return tanhf(x);
    case ACT_SIN:
        return sinf(x);
    }
    NN_ASSERT(0 && "Unreachable");
    return 0.0f;
}

float dactf(float y, Act act) {
    switch (act) {
    case ACT_SIG:
        return y * (1 - y);
    case ACT_RELU:
        return y >= 0 ? 1 : NN_RELU_PARAM;
    case ACT_TANH:
        return 1 - y * y;
    case ACT_SIN:
        return cosf(asinf(y));
    }
    NN_ASSERT(0 && "Unreachable");
    return 0.0f;
}

float rand_float(void) { return (float)rand() / (float)RAND_MAX; }

Mat mat_alloc(Region *r, size_t rows, size_t cols) {
    Mat m;
    m.rows = rows;
    m.cols = cols;
    m.elements = region_alloc(r, sizeof(*m.elements) * rows * cols);
    NN_ASSERT(m.elements != NULL);
    return m;
}

void mat_dot(Mat dst, Mat a, Mat b) {
    NN_ASSERT(a.cols == b.rows);
    size_t n = a.cols;
    NN_ASSERT(dst.rows == a.rows);
    NN_ASSERT(dst.cols == b.cols);

    for (size_t i = 0; i < dst.rows; ++i) {
        for (size_t j = 0; j < dst.cols; ++j) {
            MAT_AT(dst, i, j) = 0;
            for (size_t k = 0; k < n; ++k) {
                MAT_AT(dst, i, j) += MAT_AT(a, i, k) * MAT_AT(b, k, j);
            }
        }
    }
}

Row mat_row(Mat m, size_t row) {
    return (Row){
        .cols = m.cols,
        .elements = &MAT_AT(m, row, 0),
    };
}

void mat_copy(Mat dst, Mat src) {
    NN_ASSERT(dst.rows == src.rows);
    NN_ASSERT(dst.cols == src.cols);
    for (size_t i = 0; i < dst.rows; ++i) {
        for (size_t j = 0; j < dst.cols; ++j) {
            MAT_AT(dst, i, j) = MAT_AT(src, i, j);
        }
    }
}

void mat_sum(Mat dst, Mat a) {
    NN_ASSERT(dst.rows == a.rows);
    NN_ASSERT(dst.cols == a.cols);
    for (size_t i = 0; i < dst.rows; ++i) {
        for (size_t j = 0; j < dst.cols; ++j) {
            MAT_AT(dst, i, j) += MAT_AT(a, i, j);
        }
    }
}

void mat_act(Mat m) {
    for (size_t i = 0; i < m.rows; ++i) {
        for (size_t j = 0; j < m.cols; ++j) {
            MAT_AT(m, i, j) = actf(MAT_AT(m, i, j), NN_ACT);
        }
    }
}

void mat_print(Mat m, const char *name, size_t padding) {
    printf("%*s%s = [\n", (int)padding, "", name);
    for (size_t i = 0; i < m.rows; ++i) {
        printf("%*s    ", (int)padding, "");
        for (size_t j = 0; j < m.cols; ++j) {
            printf("%f ", MAT_AT(m, i, j));
        }
        printf("\n");
    }
    printf("%*s]\n", (int)padding, "");
}

void mat_fill(Mat m, float x) {
    for (size_t i = 0; i < m.rows; ++i) {
        for (size_t j = 0; j < m.cols; ++j) {
            MAT_AT(m, i, j) = x;
        }
    }
}

void mat_rand(Mat m, float low, float high) {
    for (size_t i = 0; i < m.rows; ++i) {
        for (size_t j = 0; j < m.cols; ++j) {
            MAT_AT(m, i, j) = rand_float() * (high - low) + low;
        }
    }
}

NN nn_alloc(Region *r, size_t *arch, size_t arch_count) {
    NN_ASSERT(arch_count > 0);

    NN nn;
    nn.arch = arch;
    nn.arch_count = arch_count;

    nn.ws = region_alloc(r, sizeof(*nn.ws) * (nn.arch_count - 1));
    NN_ASSERT(nn.ws != NULL);
    nn.bs = region_alloc(r, sizeof(*nn.bs) * (nn.arch_count - 1));
    NN_ASSERT(nn.bs != NULL);
    nn.as = region_alloc(r, sizeof(*nn.as) * nn.arch_count);
    NN_ASSERT(nn.as != NULL);

    nn.as[0] = row_alloc(r, arch[0]);
    for (size_t i = 1; i < arch_count; ++i) {
        nn.ws[i - 1] = mat_alloc(r, nn.as[i - 1].cols, arch[i]);
        nn.bs[i - 1] = row_alloc(r, arch[i]);
        nn.as[i] = row_alloc(r, arch[i]);
    }

    return nn;
}

void nn_zero(NN nn) {
    for (size_t i = 0; i < nn.arch_count - 1; ++i) {
        mat_fill(nn.ws[i], 0);
        row_fill(nn.bs[i], 0);
        row_fill(nn.as[i], 0);
    }
    row_fill(nn.as[nn.arch_count - 1], 0);
}

void nn_print(NN nn, const char *name) {
    char buf[256];
    printf("%s = [\n", name);
    for (size_t i = 0; i < nn.arch_count - 1; ++i) {
        snprintf(buf, sizeof(buf), "ws%zu", i);
        mat_print(nn.ws[i], buf, 4);
        snprintf(buf, sizeof(buf), "bs%zu", i);
        row_print(nn.bs[i], buf, 4);
    }
    printf("]\n");
}

void nn_rand(NN nn, float low, float high) {
    for (size_t i = 0; i < nn.arch_count - 1; ++i) {
        mat_rand(nn.ws[i], low, high);
        row_rand(nn.bs[i], low, high);
    }
}

void nn_forward(NN nn) {
    for (size_t i = 0; i < nn.arch_count - 1; ++i) {
        mat_dot(row_as_mat(nn.as[i + 1]), row_as_mat(nn.as[i]), nn.ws[i]);
        mat_sum(row_as_mat(nn.as[i + 1]), row_as_mat(nn.bs[i]));
        mat_act(row_as_mat(nn.as[i + 1]));
    }
}

float nn_cross_entropy(NN nn, Mat t) {
    NN_ASSERT(NN_INPUT(nn).cols + NN_OUTPUT(nn).cols == t.cols);
    size_t n = t.rows;

    float c = 0;
    for (size_t i = 0; i < n; ++i) {
        Row row = mat_row(t, i);
        Row x = row_slice(row, 0, NN_INPUT(nn).cols);
        Row y = row_slice(row, NN_INPUT(nn).cols, NN_OUTPUT(nn).cols);

        row_copy(NN_INPUT(nn), x);
        nn_forward(nn);
        size_t q = y.cols;
        for (size_t j = 0; j < q; ++j) {
            float d = logf(ROW_AT(NN_OUTPUT(nn), j)) / logf(2) * ROW_AT(y, j);
            c += -d;
        }
    }

    return c / n;
}

float nn_cost(NN nn, Mat t) {
    NN_ASSERT(NN_INPUT(nn).cols + NN_OUTPUT(nn).cols == t.cols);
    size_t n = t.rows;

    float c = 0;
    for (size_t i = 0; i < n; ++i) {
        Row row = mat_row(t, i);
        Row x = row_slice(row, 0, NN_INPUT(nn).cols);
        Row y = row_slice(row, NN_INPUT(nn).cols, NN_OUTPUT(nn).cols);

        row_copy(NN_INPUT(nn), x);
        nn_forward(nn);
        size_t q = y.cols;
        for (size_t j = 0; j < q; ++j) {
            float d = ROW_AT(NN_OUTPUT(nn), j) - ROW_AT(y, j);
            c += d * d;
        }
    }

    return c / n;
}

NN nn_backprop(Region *r, NN nn, Mat t) {
    size_t n = t.rows;
    NN_ASSERT(NN_INPUT(nn).cols + NN_OUTPUT(nn).cols == t.cols);

    NN g = nn_alloc(r, nn.arch, nn.arch_count);
    nn_zero(g);

    // i - current sample
    // l - current layer
    // j - current activation
    // k - previous activation

    for (size_t i = 0; i < n; ++i) {
        Row row = mat_row(t, i);
        Row in = row_slice(row, 0, NN_INPUT(nn).cols);
        Row out = row_slice(row, NN_INPUT(nn).cols, NN_OUTPUT(nn).cols);

        row_copy(NN_INPUT(nn), in);
        nn_forward(nn);

        for (size_t j = 0; j < nn.arch_count; ++j) {
            row_fill(g.as[j], 0);
        }

        for (size_t j = 0; j < out.cols; ++j) {
#ifdef NN_BACKPROP_TRADITIONAL
            ROW_AT(NN_OUTPUT(g), j) =
                2 * (ROW_AT(NN_OUTPUT(nn), j) - ROW_AT(out, j));
#else
            ROW_AT(NN_OUTPUT(g), j) = ROW_AT(NN_OUTPUT(nn), j) - ROW_AT(out, j);
#endif // NN_BACKPROP_TRADITIONAL
        }

#ifdef NN_BACKPROP_TRADITIONAL
        float s = 1;
#else
        float s = 2;
#endif // NN_BACKPROP_TRADITIONAL

        for (size_t l = nn.arch_count - 1; l > 0; --l) {
            for (size_t j = 0; j < nn.as[l].cols; ++j) {
                float a = ROW_AT(nn.as[l], j);
                float da = ROW_AT(g.as[l], j);
                float qa = dactf(a, NN_ACT);
                ROW_AT(g.bs[l - 1], j) += s * da * qa;
                for (size_t k = 0; k < nn.as[l - 1].cols; ++k) {
                    // j - weight matrix col
                    // k - weight matrix row
                    float pa = ROW_AT(nn.as[l - 1], k);
                    float w = MAT_AT(nn.ws[l - 1], k, j);
                    MAT_AT(g.ws[l - 1], k, j) += s * da * qa * pa;
                    ROW_AT(g.as[l - 1], k) += s * da * qa * w;
                }
            }
        }
    }

    for (size_t i = 0; i < g.arch_count - 1; ++i) {
        for (size_t j = 0; j < g.ws[i].rows; ++j) {
            for (size_t k = 0; k < g.ws[i].cols; ++k) {
                MAT_AT(g.ws[i], j, k) /= n;
            }
        }
        for (size_t k = 0; k < g.bs[i].cols; ++k) {
            ROW_AT(g.bs[i], k) /= n;
        }
    }

    return g;
}

NN nn_finite_diff(Region *r, NN nn, Mat t, float eps) {
    float saved;
    float c = nn_cost(nn, t);

    NN g = nn_alloc(r, nn.arch, nn.arch_count);

    for (size_t i = 0; i < nn.arch_count - 1; ++i) {
        for (size_t j = 0; j < nn.ws[i].rows; ++j) {
            for (size_t k = 0; k < nn.ws[i].cols; ++k) {
                saved = MAT_AT(nn.ws[i], j, k);
                MAT_AT(nn.ws[i], j, k) += eps;
                MAT_AT(g.ws[i], j, k) = (nn_cost(nn, t) - c) / eps;
                MAT_AT(nn.ws[i], j, k) = saved;
            }
        }

        for (size_t k = 0; k < nn.bs[i].cols; ++k) {
            saved = ROW_AT(nn.bs[i], k);
            ROW_AT(nn.bs[i], k) += eps;
            ROW_AT(g.bs[i], k) = (nn_cost(nn, t) - c) / eps;
            ROW_AT(nn.bs[i], k) = saved;
        }
    }

    return g;
}

void nn_learn(NN nn, NN g, float rate) {
    for (size_t i = 0; i < nn.arch_count - 1; ++i) {
        for (size_t j = 0; j < nn.ws[i].rows; ++j) {
            for (size_t k = 0; k < nn.ws[i].cols; ++k) {
                MAT_AT(nn.ws[i], j, k) -= rate * MAT_AT(g.ws[i], j, k);
            }
        }

        for (size_t k = 0; k < nn.bs[i].cols; ++k) {
            ROW_AT(nn.bs[i], k) -= rate * ROW_AT(g.bs[i], k);
        }
    }
}

void mat_shuffle_rows(Mat m) {
    for (size_t i = 0; i < m.rows; ++i) {
        size_t j = i + rand() % (m.rows - i);
        if (i != j) {
            for (size_t k = 0; k < m.cols; ++k) {
                float t = MAT_AT(m, i, k);
                MAT_AT(m, i, k) = MAT_AT(m, j, k);
                MAT_AT(m, j, k) = t;
            }
        }
    }
}

Mat mat_slice(Mat m, size_t from, size_t n) {
    Mat ret = {
        .rows = n,
        .cols = m.cols,
        .elements = &MAT_AT(m, from, 0),
    };
    return ret;
}

void batch_process(Region *r, Batch *b, size_t batch_size, NN nn, Mat t,
                   float rate) {
    if (b->finished) {
        b->finished = false;
        b->begin = 0;
        b->cost = 0;
    }

    size_t size = batch_size;
    if (b->begin + batch_size >= t.rows) {
        size = t.rows - b->begin;
    }

    // TODO: introduce similar to row_slice operation but for Mat that will give
    // you subsequence of rows
    Mat batch_t = {
        .rows = size,
        .cols = t.cols,
        .elements = &MAT_AT(t, b->begin, 0),
    };

    NN g = nn_backprop(r, nn, batch_t);
    nn_learn(nn, g, rate);
    b->cost += nn_cost(nn, batch_t);
    b->begin += batch_size;

    if (b->begin >= t.rows) {
        size_t batch_count = (t.rows + batch_size - 1) / batch_size;
        b->cost /= batch_count;
        b->finished = true;
    }
}

Region region_alloc_alloc(size_t capacity_bytes) {
    Region r = {0};

    size_t word_size = sizeof(*r.words);
    size_t capacity_words = (capacity_bytes + word_size - 1) / word_size;

    void *words = NN_MALLOC(capacity_words * word_size);
    NN_ASSERT(words != NULL);
    r.capacity = capacity_words;
    r.words = words;
    return r;
}

void *region_alloc(Region *r, size_t size_bytes) {
    if (r == NULL)
        return NN_MALLOC(size_bytes);
    size_t word_size = sizeof(*r->words);
    size_t size_words = (size_bytes + word_size - 1) / word_size;

    NN_ASSERT(r->size + size_words <= r->capacity);
    if (r->size + size_words > r->capacity)
        return NULL;
    void *result = &r->words[r->size];
    r->size += size_words;
    return result;
}

Mat row_as_mat(Row row) {
    return (Mat){
        .rows = 1,
        .cols = row.cols,
        .elements = row.elements,
    };
}

Row row_slice(Row row, size_t i, size_t cols) {
    NN_ASSERT(i < row.cols);
    NN_ASSERT(i + cols <= row.cols);
    return (Row){
        .cols = cols,
        .elements = &ROW_AT(row, i),
    };
}

#endif // NN_IMPLEMENTATION
```

## src/sb.h
```c
#ifndef SB_H
#define SB_H

#include <assert.h>
#include <stdarg.h>
#include <stdio.h>
#include <stdlib.h>
#include <string.h>

#ifndef SB_ALLOC
#define SB_ALLOC malloc
#endif

typedef struct {
    size_t size;
    size_t cap;
    char *data;
} StringBuilder;

void sb_init(StringBuilder *sb, size_t size);
int sb_append(StringBuilder *sb, const char *data, size_t len);
int sb_appendf(StringBuilder *sb, const char *format, ...);
char *sb_string(StringBuilder *sb);
void sb_free(StringBuilder *sb);

#ifdef SB_IMPLEMENTATION

void sb_init(StringBuilder *sb, size_t size) {
    sb->size = 0;
    sb->cap = size;
    sb->data = SB_ALLOC(size);
    assert(sb->data);
}

int sb_append(StringBuilder *sb, const char *data, size_t len) {
    if (sb->size + len > sb->cap) {
        sb->data = realloc(sb->data, sb->cap * 2);
        sb->cap *= 2;
        assert(sb->data);
    }
    memcpy(&sb->data[sb->size], data, len);
    sb->size += len;
    return EXIT_SUCCESS;
}

int sb_appendf(StringBuilder *sb, const char *format, ...) {
    char buf[1024];
    va_list args;
    va_start(args, format);
    int rc = vsnprintf(buf, sizeof(buf), format, args);
    va_end(args);

    if (rc < 0) {
        printf("ERROR: could not append to StringBuilder\n");
        return EXIT_FAILURE;
    }
    return sb_append(sb, buf, strlen(buf));
}

unsigned char *sb_bytes(StringBuilder *sb) {
    unsigned char *s = SB_ALLOC(sb->size);
    memcpy(s, sb->data, sb->size);
    return s;
}

char *sb_string(StringBuilder *sb) {
    char *s = SB_ALLOC(sb->size + 1);
    memcpy(s, sb->data, sb->size);
    s[sb->size] = '\0';
    return s;
}

void sb_free(StringBuilder *sb) {
    free(sb->data);
    sb->size = 0;
    sb->cap = 0;
}

#endif // SB_IMPLEMENTATION

#endif // ! SB_H
```

## src/train.c
```c
#define NN_IMPLEMENTATION
#define CSON_IMPLEMENTATION
#define SB_IMPLEMENTATION
#define COMMON_IMPLEMENTATION
#include "train.h"

void train(Trainer *t) {
    // printf("Sample cols: %zu, Model input: %zu, Model output %zu\n",
    //        t->samples.cols, NN_INPUT(t->model).cols,
    //        NN_OUTPUT(t->model).cols);
    int NUM_BATCHES = t->n_images / BATCH_SIZE;
    float rate = 1.0;

    for (int epoch = 0; epoch < NUM_EPOCHS; ++epoch) {
        printf("Epoch %d\n", epoch);
        float acc = 0.0;
        for (int batch = 0; batch < NUM_BATCHES; ++batch) {
            size_t from = batch * BATCH_SIZE;
            Mat sample = mat_slice(t->samples, from, BATCH_SIZE);
            Region temp = region_alloc_alloc(500 * 1024);
            NN g = nn_backprop(&temp, t->model, sample);
            nn_learn(t->model, g, rate);
            k_free(temp.words);
            float acc_temp = accuracy(t->model, sample);
            acc += acc_temp;
        }
        printf("Epoch %d. Accuracy: %f\n", epoch, acc / NUM_BATCHES);
    }
}
```
